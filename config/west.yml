## config/west.yml
```yaml
manifest:
  remotes:
    - name: zmkfirmware
      url-base: https://github.com/zmkfirmware
  projects:
    - name: zmk
      remote: zmkfirmware
      revision: 53bec710d869440508ebc03fe99bf72d7a8466bc
      import: app/west.yml
  self:
    path: config
```
